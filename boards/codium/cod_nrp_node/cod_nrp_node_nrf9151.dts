/*
 * Copyright (c) 2025 Codium Electronique
 * All rights reserved.
 */

/dts-v1/;

#include <nordic/nrf9151_laca.dtsi>
#include "cod_nrp_node_nrf9151_common.dtsi"

/ {
	chosen {
		zephyr,sram = &sram0_s;
		zephyr,flash = &flash0;
		zephyr,code-partition = &slot0_partition;
		zephyr,sram-secure-partition = &sram0_s;
		zephyr,sram-non-secure-partition = &sram0_ns;
	};
};
