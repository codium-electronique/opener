/*
 * Copyright (c) 2025 Codium Electronique
 * All rights reserved.
 */

/dts-v1/;

#include <nordic/nrf54l15_cpuapp.dtsi>
#include "cod_nrp_node_nrf54l15_cpuapp_common.dtsi"

/ {
	compatible = "codium,cod_nrp_node_nrf54l15-cpuapp";
	model = "Codium COD NRP NODE nRF54L15 Application MCU";

	chosen {
		zephyr,code-partition = &slot0_partition;
		zephyr,sram = &cpuapp_sram;
	};
};

/* Include default memory partition configuration file */
#include <vendor/nordic/nrf54l15_cpuapp_partition.dtsi>
