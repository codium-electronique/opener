## boards/codium/cod_nrp_gw/Kconfig.defconfig
```kconfig
# Copyright (c) 2026 Codium Electronique
# SPDX-License-Identifier: Apache-2.0
#
# Codium NRP COD GW board configuration

config HW_STACK_PROTECTION
	default ARCH_HAS_STACK_PROTECTION

config BOARD_COD_NRP_GW
	select USE_DT_CODE_PARTITION if BOARD_COD_NRP_GW_NRF9151_NS
```

## boards/codium/cod_nrp_gw/board.yml
```yaml
# Copyright (c) 2026 Codium Electronique
# SPDX-License-Identifier: Apache-2.0

board:
  name: cod_nrp_gw
  full_name: Codium NR+ Gateway
  vendor: codium
  socs:
  - name: nrf9151
    variants:
    - name: 'ns'
  revision:
    format: major.minor.patch
    default: "0.1.0"
    revisions:
    - name: "0.1.0"
runners:
  run_once:
    '--recover':
      - runners:
          - nrfjprog
          - nrfutil
        run: first
        groups:
          - boards:
              - cod_nrp_gw/nrf9151
              - cod_nrp_gw/nrf9151/ns
    '--erase':
      - runners:
          - nrfjprog
          - jlink
          - nrfutil
        run: first
        groups:
          - boards:
              - cod_nrp_gw/nrf9151
              - cod_nrp_gw/nrf9151/ns
    '--reset':
      - runners:
          - nrfjprog
          - jlink
          - nrfutil
        run: last
        groups:
          - boards:
              - cod_nrp_gw/nrf9151
              - cod_nrp_gw/nrf9151/ns
```

## boards/codium/cod_nrp_gw/cod_nrp_gw_nrf9151_ns_defconfig
```kconfig
# Copyright (c) 2025 Codium Electronique
# SPDX-License-Identifier: Apache-2.0

# Enable MPU
CONFIG_ARM_MPU=y

# Enable TrustZone-M
CONFIG_ARM_TRUSTZONE_M=y

# This board implies building Non-Secure firmware
CONFIG_TRUSTED_EXECUTION_NONSECURE=y

# Enable GPIO
CONFIG_GPIO=y

# Enable UART driver
CONFIG_SERIAL=y

# Enable console
CONFIG_CONSOLE=y
CONFIG_UART_CONSOLE=y

# Enable SPI
CONFIG_SPI=y
CONFIG_SPI_ASYNC=y
CONFIG_SPI_SLAVE=y

# SPI flash
CONFIG_FLASH=y
CONFIG_STREAM_FLASH=y
CONFIG_FLASH_MAP=y
CONFIG_FLASH_PAGE_LAYOUT=y
CONFIG_STREAM_FLASH_ERASE=y
CONFIG_MPU_ALLOW_FLASH_WRITE=y

CONFIG_SPI_NOR=y
CONFIG_SPI_NOR_SFDP_RUNTIME=y
CONFIG_SPI_NOR_FLASH_LAYOUT_PAGE_SIZE=4096
```

## boards/codium/cod_nrp_node/Kconfig.cod_nrp_node
```kconfig
# Copyright (c) 2025 Codium Electronique SAS
# All rights reserved.
#
# Codium COD NRP NODE board configuration

config BOARD_COD_NRP_NODE
	select SOC_NRF9151_LACA if BOARD_COD_NRP_NODE_NRF9151 || BOARD_COD_NRP_NODE_NRF9151_NS
	select SOC_NRF54L15_CPUAPP if BOARD_COD_NRP_NODE_NRF54L15_CPUAPP || BOARD_COD_NRP_NODE_NRF54L15_CPUAPP_NS
```

## boards/codium/cod_nrp_node/Kconfig.defconfig
```kconfig
# Copyright (c) 2025 Codium Electronique
# All rights reserved.
#
# Codium COD NRP NODE board configuration

config HW_STACK_PROTECTION
	default ARCH_HAS_STACK_PROTECTION

if BOARD_COD_NRP_NODE_NRF9151 || BOARD_COD_NRP_NODE_NRF9151_NS

config BOARD_COD_NRP_NODE
	select USE_DT_CODE_PARTITION if BOARD_COD_NRP_NODE_NRF9151_NS

config BT_HCI_VS
	default y if BT

config BT_WAIT_NOP
	default BT && $(dt_nodelabel_enabled,nrf54l15_reset)

config BOARD_LSM6DSL
	bool
	default n
	default y if $(dt_nodelabel_enabled,lsm6dsl)
	select CONFIG_LSM6DSL
	select CONFIG_LSM6DSL_TRIGGER_OWN_THREAD
	select CONFIG_LSM6DSL_EXT0_LIS2MDL

config BOARD_LIS2MDL
	bool
	default n
	default y if $(dt_nodelabel_enabled,lsm6dsl)
	#select CONFIG_LIS2MDL

endif # BOARD_COD_NRP_NODE_NRF9151 || BOARD_COD_NRP_NODE_NRF9151_NS

if BOARD_COD_NRP_NODE_NRF54L15_CPUAPP_NS

config BOARD_COD_NRP_NODE
	select USE_DT_CODE_PARTITION if BOARD_COD_NRP_NODE_NRF54L15_CPUAPP_NS

config HAS_BT_CTLR
	default BT

config BT_WAIT_NOP
	default BT && $(dt_nodelabel_enabled,nrf54l15_reset)

# By default, if we build for a Non-Secure version of the board,
# enable building with TF-M as the Secure Execution Environment.
config BUILD_WITH_TFM
	default y

endif # BOARD_COD_NRP_NODE_NRF54L15_CPUAPP_NS
```

## boards/codium/cod_nrp_node/board.yml
```yaml
# Copyright (c) 2025 Codium Electronique
# All rights reserved.

board:
  name: cod_nrp_node
  full_name: COD NRP NODE
  vendor: codium
  socs:
  - name: nrf9151
    variants:
    - name: 'ns'
  - name: nrf54l15
    variants:
      - name: 'ns'
        cpucluster: cpuapp
runners:
  run_once:
    '--recover':
      - runners:
          - nrfjprog
          - nrfutil
        run: first
        groups:
          - boards:
              - cod_nrp_node/nrf9151
              - cod_nrp_node/nrf9151/ns
              - cod_nrp_node/nrf54l15/cpuapp
              - cod_nrp_node/nrf54l15/cpuapp/ns
    '--erase':
      - runners:
          - nrfjprog
          - jlink
          - nrfutil
        run: first
        groups:
          - boards:
              - cod_nrp_node/nrf9151
              - cod_nrp_node/nrf9151/ns
              - cod_nrp_node/nrf54l15/cpuapp
              - cod_nrp_node/nrf54l15/cpuapp/ns
    '--reset':
      - runners:
          - nrfjprog
          - jlink
          - nrfutil
        run: last
        groups:
          - boards:
              - cod_nrp_node/nrf9151
              - cod_nrp_node/nrf9151/ns
              - cod_nrp_node/nrf54l15/cpuapp
              - cod_nrp_node/nrf54l15/cpuapp/ns
```

## boards/codium/cod_nrp_node/cod_nrp_node_nrf9151_ns_defconfig
```kconfig
# Copyright (c) 2025 Codium Electronique
# All rights reserved.

# Enable MPU
CONFIG_ARM_MPU=y

# Enable TrustZone-M
CONFIG_ARM_TRUSTZONE_M=y

# This board implies building Non-Secure firmware
CONFIG_TRUSTED_EXECUTION_NONSECURE=y

# Enable GPIO
CONFIG_GPIO=y

# Enable UART driver
CONFIG_SERIAL=y
# FIXME: re-enable for rev B lpuart
#CONFIG_UART_ASYNC_API=y
#CONFIG_UART_INTERRUPT_DRIVEN=y
#CONFIG_UART_1_ASYNC=y
#CONFIG_UART_1_INTERRUPT_DRIVEN=n
#CONFIG_NRF_SW_LPUART=y
#CONFIG_NRF_SW_LPUART_INT_DRIVEN=y

# Enable console
CONFIG_CONSOLE=y
CONFIG_UART_CONSOLE=y

# Enable SPI
CONFIG_SPI=y

# SPI flash
CONFIG_FLASH=y
CONFIG_STREAM_FLASH=y
CONFIG_FLASH_MAP=y
CONFIG_FLASH_PAGE_LAYOUT=y
CONFIG_STREAM_FLASH_ERASE=y
CONFIG_MPU_ALLOW_FLASH_WRITE=y

CONFIG_SPI_NOR=y
CONFIG_SPI_NOR_SFDP_RUNTIME=y
CONFIG_SPI_NOR_FLASH_LAYOUT_PAGE_SIZE=4096
CONFIG_SPI_NOR_ACTIVE_DWELL_MS=10
```

## dts/bindings/spinel/opener,spinel-spi.yaml
```yaml
# Copyright (c) 2026 Codium Electronique
# SPDX-License-Identifier: Apache-2.0

description: |
  Spinel interface over SPI, the device being the SPI slave
  (CONFIG_DECTNRP_SPINEL_TRANSPORT_SPI). The node is a child of the SPI slave
  controller. IRQ is active while the device has a frame for the host; BUSY
  is active while the device is not ready for a transaction. Set the
  controller's def-char to 0xff, so that a transaction clocked while the
  device is not ready reads an invalid header.

compatible: "opener,spinel-spi"

include: spi-device.yaml

properties:
  irq-gpios:
    type: phandle-array
    required: true
    description: Output to the host, active while a frame waits to be clocked.

  busy-gpios:
    type: phandle-array
    required: true
    description: Output to the host, active while the SPI slave is not armed.
```

## subsys/spinel/Kconfig
```kconfig
# Copyright (c) 2026 Codium Electronique
# SPDX-License-Identifier: Apache-2.0

menuconfig DECTNRP_SPINEL
	bool "DECT NR+ Spinel interface"
	depends on DECTNRP_DRIVER_SCHEDULED_API
	depends on NETWORKING
	select CRC
	select NET_BUF
	help
	  Spinel interface giving a host processor control of the DECT NR+
	  stack, like the OpenThread radio co-processor (RCP) interface.

if DECTNRP_SPINEL

config DECTNRP_SPINEL_MAX_FRAME_SIZE
	int "Maximum Spinel frame size"
	default 1300
	help
	  Maximum size in bytes of a Spinel frame, before transport framing.
	  The default (the Spinel default) fits a DECTNRP_MTU message plus
	  headers.

config DECTNRP_SPINEL_OP_SLOTS
	int "Number of in-flight driver operations"
	default 8
	help
	  Number of driver operations the host can have queued at once.

config DECTNRP_SPINEL_EVENT_BUFS
	int "Number of event buffers"
	default 16
	help
	  Number of driver events that can wait to be sent to the host.

config DECTNRP_SPINEL_TX_BUFS
	int "Number of frame buffers to the host"
	default 4

config DECTNRP_SPINEL_RX_BUFS
	int "Number of frame buffers from the host"
	default 4

config DECTNRP_SPINEL_THREAD_STACK_SIZE
	int "Spinel thread stack size"
	default 2048

config DECTNRP_SPINEL_THREAD_PRIO
	int "Spinel thread priority"
	default 5

config DECTNRP_SPINEL_RESET_TIMEOUT_MS
	int "Reset timeout in milliseconds"
	default 1000
	help
	  Maximum time to wait for the in-flight driver operations to finish
	  when the host resets the interface.

choice DECTNRP_SPINEL_LEVEL
	prompt "Spinel control level"
	default DECTNRP_SPINEL_LEVEL_DRIVER

config DECTNRP_SPINEL_LEVEL_DRIVER
	bool "Driver"
	help
	  Spinel drives the DECT NR+ driver; the L2 runs on the host.

endchoice

DT_CHOSEN_SPINEL_UART := opener,spinel-uart

choice DECTNRP_SPINEL_TRANSPORT
	prompt "Spinel transport"
	default DECTNRP_SPINEL_TRANSPORT_SPI if DT_HAS_OPENER_SPINEL_SPI_ENABLED
	default DECTNRP_SPINEL_TRANSPORT_UART

config DECTNRP_SPINEL_TRANSPORT_UART
	bool "UART with HDLC-lite framing"
	depends on $(dt_chosen_enabled,$(DT_CHOSEN_SPINEL_UART))
	select SERIAL
	select UART_INTERRUPT_DRIVEN
	help
	  Spinel frames in HDLC-lite framing on the UART chosen as
	  opener,spinel-uart in the devicetree.

config DECTNRP_SPINEL_TRANSPORT_SPI
	bool "SPI slave with OpenThread Spinel SPI framing"
	depends on DT_HAS_OPENER_SPINEL_SPI_ENABLED
	select SPI
	select SPI_SLAVE
	select SPI_ASYNC
	select GPIO
	help
	  Spinel frames in the Spinel SPI framing, the device being the SPI
	  slave of the first opener,spinel-spi devicetree node, with IRQ and
	  BUSY lines to the host.

config DECTNRP_SPINEL_TRANSPORT_NONE
	bool "None (tests only)"

endchoice

if DECTNRP_SPINEL_TRANSPORT_SPI

config DECTNRP_SPINEL_SPI_STACK_SIZE
	int "SPI transport thread stack size"
	default 1024

config DECTNRP_SPINEL_SPI_TX_TIMEOUT_MS
	int "SPI frame timeout in milliseconds"
	default 1000
	help
	  Time a frame to the host waits for the host to clock it. A frame
	  still waiting after it is dropped and counted as a transport error.

endif # DECTNRP_SPINEL_TRANSPORT_SPI

module = DECTNRP_SPINEL
module-str = DECT NR+ Spinel
source "subsys/logging/Kconfig.template.log_config"

endif # DECTNRP_SPINEL
```

## tests/subsys/spinel/codec/testcase.yaml
```yaml
# Copyright (c) 2026 Codium Electronique
# SPDX-License-Identifier: Apache-2.0

tests:
  opener.spinel.codec:
    platform_allow: native_sim/native/64
    integration_platforms:
      - native_sim/native/64
```

## tests/subsys/spinel/common/Kconfig.mock
```kconfig
# Copyright (c) 2026 Codium Electronique
# SPDX-License-Identifier: Apache-2.0

# Mock DECT NR+ driver for the Spinel tests, see mock_driver.h.

config DECTNRP_DRIVER_MOCK
	bool "Mock DECT NR+ driver"
	depends on DECTNRP_DRIVER_SCHEDULED_API
	depends on NETWORKING

if DECTNRP_DRIVER_MOCK

# Radio capabilities: the nRF91x1 driver defaults.

config DECTNRP_DRIVER_RDCAP_DECTNRP_RELEASE
	int
	default 1

config DECTNRP_DRIVER_RDCAP_POWERCLASS_MAX
	int
	default 2

config DECTNRP_DRIVER_RDCAP_NSS_RX_MAX
	int
	default 1

config DECTNRP_DRIVER_RDCAP_RXTX_DIVERSITY_MAX
	int
	default 1

config DECTNRP_DRIVER_RDCAP_RXGAIN_DB
	int
	default -4

config DECTNRP_DRIVER_RDCAP_MCS_MAX
	int
	default 4

config DECTNRP_DRIVER_RDCAP_SOFTBUFFERSIZE_BYTES_MAX
	int
	default 25344

config DECTNRP_DRIVER_RDCAP_HARQ_PROC_MAX
	int
	default 8

config DECTNRP_DRIVER_RDCAP_HARQ_FEEDBACKDELAY
	int
	default 2

config DECTNRP_DRIVER_RDCAP_MU_MAX
	int
	default 1

config DECTNRP_DRIVER_RDCAP_BETA_MAX
	int
	default 1

config DECTNRP_DRIVER_MODEMTICKS_PER_SYMBOL
	int
	default 2880

config DECTNRP_DRIVER_MOCK_AUTO
	bool "Simulate the radio"
	help
	  Run scheduled operations against a simulated radio, for host
	  integration tests.

config DECTNRP_DRIVER_MOCK_AUTO_EMIT_PERIOD_MS
	int "Period of the simulated received frames"
	depends on DECTNRP_DRIVER_MOCK_AUTO
	default 100

endif # DECTNRP_DRIVER_MOCK
```

## tests/subsys/spinel/core/testcase.yaml
```yaml
# Copyright (c) 2026 Codium Electronique
# SPDX-License-Identifier: Apache-2.0

tests:
  opener.spinel.core:
    platform_allow: native_sim/native/64
    integration_platforms:
      - native_sim/native/64
```

## tests/subsys/spinel/mock/testcase.yaml
```yaml
# Copyright (c) 2026 Codium Electronique
# SPDX-License-Identifier: Apache-2.0

tests:
  opener.spinel.mock:
    platform_allow: native_sim/native/64
    integration_platforms:
      - native_sim/native/64
```

## tests/subsys/spinel/ops/testcase.yaml
```yaml
tests:
  opener.spinel.ops:
    platform_allow: native_sim/native/64
    integration_platforms:
      - native_sim/native/64
```

## tests/subsys/spinel/simdev/testcase.yaml
```yaml
tests:
  opener.spinel.simdev:
    build_only: true
    platform_allow: native_sim/native/64
    integration_platforms:
      - native_sim/native/64
```

## tests/subsys/spinel/spi_transport/testcase.yaml
```yaml
# Copyright (c) 2026 Codium Electronique
# SPDX-License-Identifier: Apache-2.0

tests:
  opener.spinel.spi_transport:
    platform_allow: native_sim/native/64
    integration_platforms:
      - native_sim/native/64
    timeout: 60
```
