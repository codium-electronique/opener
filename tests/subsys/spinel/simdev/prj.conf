## CMakeLists.txt
```
# Copyright (c) 2026 Codium Electronique
# SPDX-License-Identifier: Apache-2.0

cmake_minimum_required(VERSION 3.20.0)
find_package(Zephyr REQUIRED HINTS $ENV{ZEPHYR_BASE})
project(spinel_simdev)

target_sources(app PRIVATE src/main.c)
include(${CMAKE_CURRENT_LIST_DIR}/../common/CMakeLists.inc)
```

## prj.conf
```kconfig
# Copyright (c) 2026 Codium Electronique
# SPDX-License-Identifier: Apache-2.0

CONFIG_NETWORKING=y
CONFIG_NET_TEST=y
CONFIG_DECTNRP_DRIVER_SCHEDULED_API=y
CONFIG_DECTNRP_DRIVER_MOCK=y
CONFIG_DECTNRP_DRIVER_MOCK_AUTO=y
CONFIG_DECTNRP_SPINEL=y
CONFIG_DECTNRP_SPINEL_TRANSPORT_UART=y
CONFIG_NATIVE_SIM_SLOWDOWN_TO_REAL_TIME=y
```

## app.overlay
```dts
/*
 * Copyright (c) 2026 Codium Electronique
 * SPDX-License-Identifier: Apache-2.0
 */

/* The host talks Spinel over the second native_sim UART, on its own pty. */

/ {
	chosen {
		opener,spinel-uart = &uart1;
	};
};

&uart1 {
	status = "okay";
};
```

## src/main.c
```c
/*
 * Copyright (c) 2026 Codium Electronique
 * SPDX-License-Identifier: Apache-2.0
 */

/*
 * Simulated Spinel device for the host integration tests: the Spinel
 * subsystem starts on its own and drives the mock driver in auto mode.
 */

int main(void)
{
	return 0;
}
```
